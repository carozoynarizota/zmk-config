## boards/shields/two_keys/Kconfig.defconfig
```kconfig
if SHIELD_TWO_KEYS
            
config ZMK_KEYBOARD_NAME
    default "two_keys"

endif
```

## config/boards/shields/mywhoosh_kbd/Kconfig.defconfig
```kconfig
if SHIELD_MYWHOOSH_KBD

config ZMK_KEYBOARD_NAME
    default "MyWhoosh_KBD"

endif
```
